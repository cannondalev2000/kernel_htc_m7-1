## arch/arm/mach-msm/htc/Kconfig.board
```kconfig
#
# Include the specific Kconfig file for HTC board
#

# M7
source "arch/arm/mach-msm/htc/m7/Kconfig"

config MACH_HTC_DUMMY
	bool "NONE (No device)"
```
